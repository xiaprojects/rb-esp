## sdkconfig.defaults
```kconfig
CONFIG_LV_FONT_MONTSERRAT_48=y
CONFIG_LV_FONT_DEFAULT_MONTSERRAT_48=y
CONFIG_LV_FONT_MONTSERRAT_24=y
CONFIG_LV_FONT_MONTSERRAT_32=y
CONFIG_LV_FONT_MONTSERRAT_16=y


CONFIG_LV_USE_FS_STDIO=y
CONFIG_LV_FS_STDIO_LETTER="A"
CONFIG_LV_FS_STDIO_PATH="/sdcard"
CONFIG_LV_FS_STDIO_CACHE_SIZE="128"

CONFIG_LV_USE_BMP=y
```
